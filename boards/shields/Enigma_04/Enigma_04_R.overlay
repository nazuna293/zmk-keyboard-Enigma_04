#include "Enigma_04_kbd.dtsi"

&transform_kbd0 {
    col-offset = <5>;
};

&kscan_kbd0 {
        col-gpios= <&gpio GPIO_ACTIVE_HIGH>,
              <&gpio GPIO_ACTIVE_HIGH>,
              <&gpio GPIO_ACTIVE_HIGH>,
              <&gpio GPIO_ACTIVE_HIGH>,
              <&gpio GPIO_ACTIVE_HIGH>;
};

&transform_kbd1 {
    col-offset = <5>;
};

&kscan_kbd1 {
        gpios = <&gpio GPIO_ACTIVE_HIGH>,
            <&gpio GPIO_ACTIVE_HIGH>,
            <&gpio GPIO_ACTIVE_HIGH>,
            <&gpio GPIO_ACTIVE_HIGH>,
            <&gpio GPIO_ACTIVE_HIGH>;
};
