#include "Enigma_04.dtsi"
#include "Enigma_04_kbd_layouts.dtsi"

/ {
    chosen {
        zmk,kscan = &kscan_kbd0;
        zmk,physical-layout = &layout_kbd1;
    };
};

&kscan_kbd0 {
        col-gpios = <&gpio1 11 GPIO_ACTIVE_HIGH>,
              <&gpio0 5 GPIO_ACTIVE_HIGH>,
              <&gpio0 4 GPIO_ACTIVE_HIGH>,
              <&gpio0 29 GPIO_ACTIVE_HIGH>,
              <&gpio0 28 GPIO_ACTIVE_HIGH>;
};
