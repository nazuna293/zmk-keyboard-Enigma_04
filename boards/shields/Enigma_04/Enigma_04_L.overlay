#include "Enigma_04_kbd.dtsi"

&kscan_kbd0 {
        col-gpios = <&gpio GPIO_ACTIVE_HIGH>,
              <&gpio GPIO_ACTIVE_HIGH>,
              <&gpio GPIO_ACTIVE_HIGH>,
              <&gpio GPIO_ACTIVE_HIGH>,
              <&gpio GPIO_ACTIVE_HIGH>;
};

&kscan_kbd1 {
        gpios = <&gpio GPIO_ACTIVE_HIGH>,
                <&gpio GPIO_ACTIVE_HIGH>,
                <&gpio GPIO_ACTIVE_HIGH>,
                <&gpio GPIO_ACTIVE_HIGH>,
                <&gpio GPIO_ACTIVE_HIGH>;
};
