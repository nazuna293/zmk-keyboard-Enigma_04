## boards/shields/Enigma_04/Kconfig.defconfig
```kconfig
if SHIELD_Enigma_04_L

config ZMK_KEYBOARD_NAME
    default "Enigma_04"

config ZMK_USB
	default y

config ZMK_BLE
    default y

config ZMK_SPLIT_ROLE_CENTRAL
    default y


endif

if SHIELD_Enigma_04_L || SHIELD_Enigma_04_R

config NFCT_PINS_AS_GPIOS
    default y

config ZMK_SPLIT
    default y

# Battery
config ZMK_BATTERY
	default y

config ZMK_BATTERY_REPORTING
	default y

config BT_BAS
	default y

# ZMK studio
config ZMK_STUDIO
	default y

config ZMK_STUDIO_LOCKING
	default n

endif
```

## boards/shields/Enigma_04/Kconfig.shield
```kconfig
config SHIELD_Enigma_04_kbd_o_L
    def_bool $(shields_list_contains,Enigma_04_kbd_o_L)

config SHIELD_Enigma_04_kbd_o_R
    def_bool $(shields_list_contains,Enigma_04_kbd_o_R)

config SHIELD_Enigma_04_kbd_q_L
    def_bool $(shields_list_contains,Enigma_04_kbd_q_L)

config SHIELD_Enigma_04_kbd_q_R
    def_bool $(shields_list_contains,Enigma_04_kbd_q_R)
```

## boards/shields/Enogma_04/Kconfig.shield
```kconfig
config SHIELD_Enigma_04_R
    def_bool $(shields_list_contains,_Enigma_04_R)

config SHIELD_Enigma_04_L
    def_bool $(shields_list_contains,Enigma_04_
```
